## conf/distro/pinix.conf
```bitbake
require conf/distro/poky.conf

DISTRO = "pinix"
DISTRO_NAME = "PinIx"
DISTRO_VERSION = "2.0"
DISTRO_CODENAME = "pinix"
SDK_VENDOR = "-pine64"
TARGET_VENDOR = "-pine64"

MAINTAINER = "Justin Hammond <justin@dynam.ac>"


# Comment out any of the lines below to disable them in the build
# DISTRO_FEATURES options:
# alsa bluetooth ext2 pcmcia usbgadget usbhost wifi nfs zeroconf pci
DISTRO_FEATURES = " pci \
                    ipv4 \
                    ipv6 \
                    usbhost \
                    wifi \
                    alsa \
                    bluetooth \
                    nfs \
                    zeroconf \
                    systemd \
                    wayland \
                    pam \
                    opengl \
                    x11 \
                    seccomp \
                    polkit \
		            kde \
		            xattr \
                    acl \
                    pulseaudio \
"

DISTRO_FEATURES:remove = " sysvinit \
"

DISTRO_FEATURES:append = " systemd"
VIRTUAL-RUNTIME_init_manager = "systemd"
DISTRO_FEATURES_BACKFILL_CONSIDERED = "sysvinit"
VIRTUAL-RUNTIME_initscripts = ""

PREFERRED_PROVIDER:virtual/sshd ?= "openssh"
PREFERRED_RPROVIDER:ssh ?= "openssh"

PACKAGE_CLASSES ?= "package_deb"

POKY_INIT_MANAGER:star64 = "systemd"

INITRAMFS_FSTYPES = "cpio.gz"
INITRAMFS_IMAGE = "star64-image-initramfs"
LICENSE_FLAGS_ACCEPTED = "commercial"
QT_LTS_GIT_PROTOCOL = "https"

FULL_OPTIMIZATION  += " -mtune=sifive-u74"

#Mask out these recipes as the meta-kde-gear provides them
BBMASK:append = " \
    yocto-meta-kde/recipes-playground/kjournald_git.bb \
"

COMPATIBLE_HOST:pn-bcc:riscv64 = "null"
COMPATIBLE_HOST:pn-libphonenumber:riscv64 = "null"
COMPATIBLE_HOST:pn-plasma-mobile:riscv64 = "null"
COMPATIBLE_HOST:pn-bpftrace:riscv64 = "null"
COMPATIBLE_HOST:pn-packagegroup-plasma-mobile-workspace:riscv64 = "null"
COMPATIBLE_HOST:pn-packagegroup-plasma-mobile:riscv64 = "null"
COMPATIBLE_HOST:pn-maliit-plugins-qt5:riscv64 = "null"
COMPATIBLE_HOST:pn-qtopcua:riscv64 = "null"
COMPATIBLE_HOST:pn-mozjs-78:riscv64 = "null"
COMPATIBLE_HOST:pn-openmp:riscv64 = "null"
```

## conf/distro/star64.conf
```bitbake
require conf/distro/poky.conf

DISTRO = "star64"
DISTRO_NAME = "star64"
DISTRO_VERSION = "0.1"
DISTRO_CODENAME = ""
SDK_VENDOR = "-pine64"
TARGET_VENDOR = "-pine64"

MAINTAINER = "Justin Hammond <justin@dynam.ac>"


# Comment out any of the lines below to disable them in the build
# DISTRO_FEATURES options:
# alsa bluetooth ext2 pcmcia usbgadget usbhost wifi nfs zeroconf pci
DISTRO_FEATURES = " pci \
                    ipv4 \
                    ipv6 \
                    usbhost \
                    wifi \
                    alsa \
                    bluetooth \
                    nfs \
                    zeroconf \
                    systemd \
                    wayland \
                    pam \
                    opengl \
                    x11 \
                    seccomp \
                    polkit \
		    kde \
		    xattr \
"

DISTRO_FEATURES:remove = " sysvinit \
"

DISTRO_FEATURES:append = " systemd"
VIRTUAL-RUNTIME_init_manager = "systemd"
DISTRO_FEATURES_BACKFILL_CONSIDERED = "sysvinit"
VIRTUAL-RUNTIME_initscripts = ""

PACKAGE_CLASSES ?= "package_deb"

PACKAGE_FEED_URIS = "https://pine64.my-ho.st:8443/deb/"
PACKAGE_FEED_ARCHS = "all star64 riscv64"

POKY_INIT_MANAGER:star64 = "systemd"

INITRAMFS_FSTYPES = "cpio.gz"
INITRAMFS_IMAGE = "star64-image-initramfs"
LICENSE_FLAGS_ACCEPTED = "commercial"
QT_LTS_GIT_PROTOCOL = "https"
```

## conf/layer.conf
```bitbake
# We have a conf and classes directory, add to BBPATH
BBPATH .= ":${LAYERDIR}"

# We have recipes-* directories, add to BBFILES
BBFILES += "${LAYERDIR}/recipes-*/*/*.bb \
            ${LAYERDIR}/recipes-*/*/*.bbappend"

BBFILE_COLLECTIONS += "meta-pine64"
BBFILE_PATTERN_meta-pine64 = "^${LAYERDIR}/"
BBFILE_PRIORITY_meta-pine64 = "6"

LAYERDEPENDS_meta-pine64 = "core"
LAYERSERIES_COMPAT_meta-pine64 = "mickledore"
```
